## main/Kconfig.projbuild
```kconfig
menu "Experiment 4: Wi-Fi Servo"

    config WIFI_SSID
        string "Wi-Fi SSID"
        default ""
        help
            SSID of the Wi-Fi network to connect to.

    config WIFI_PASSWORD
        string "Wi-Fi Password"
        default ""
        help
            Password for the Wi-Fi network.

endmenu
```
